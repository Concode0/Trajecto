## TrajectoFW/sdkconfig.defaults
```kconfig
CONFIG_EXAMPLE_I2C_SDA_GPIO=10
CONFIG_EXAMPLE_I2C_SCL_GPIO=4
CONFIG_ESPP_I2C_USE_NEW_API=y
CONFIG_BT_ENABLED=y
CONFIG_BT_NIMBLE_ENABLED=y
CONFIG_BT_HOST_NIMBLE=y
CONFIG_BT_HOST="NimBLE"
```
